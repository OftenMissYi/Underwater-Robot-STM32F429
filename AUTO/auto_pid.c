#include "auto_pid.h"
#include "math.h"
#include "pid.h"

float K_Angel_Speed[6] = {0.3,0.3,0.3,0.1,0.1,0.1}; //角度想转得快就设大,分别为滚转，俯仰，偏航，深度Z，X，Y

float X_Y[101] = {
-0.997527,-0.996859,-0.99601,-0.994933,-0.993568,
-0.991837,-0.989646,-0.986875,-0.983374,-0.978959,
-0.973403,-0.966431,-0.95771,-0.946849,-0.933392,
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0.993568,0.994933,0.99601,0.996859,0.997527
};

/*x属于[-1,1]，输入当前角度差和准备旋转时的角度差，输出期望角速度*/
float angel_speed(const float error_angel, const float max_error_angel, int i)
{
	float output;
	int x;
	if(error_angel < 0)
		x = (int)(50 * error_angel / max_error_angel) + 50;
	if(error_angel >= 0)
		x = (int)(50 * error_angel / max_error_angel) + 50;
	if(x < 0) x = 0;
	if(x > 100) x = 100;
	
	output = (K_Angel_Speed[i] * max_error_angel) * X_Y[x];
	
	return output;
}

/*算出PWM增量，输入期望角速度与当前角速度差*/
int PI_Calc(PidObject* pid, const float error_angel_speed) 
{
	int output; 
	pid->error = error_angel_speed;  
	output = (int)(pid->kp * pid->error - pid->kd * pid->prevError);	
	pid->prevError = pid->error;
	
	return output;
}




