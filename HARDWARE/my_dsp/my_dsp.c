//STM32F10x 内部系统的配置

#include "my_dsp.h"


/*****************************************************
  函数名：FILTER_median
  描  述：中位值滤波：连续采样N次(N取奇数)，
        把N次采样值按大小排列，取中间值为本次有效值。
        适用范围能有效克服因偶然因素引起的波动干扰，
        对温度、液位的变化缓慢的被测参数有良好的滤波效果。
        不过对流量、速度等快速变化的参数不宜。
        
		  中位值平均滤波：连续采用N个数据，去掉一个最大值
        和一个最小值，然后计算N-2个数据的算术平均值。
        适用范围：对应偶然出现的脉冲性干扰，可消除由于脉冲
        干扰所引起的采样值偏差。但是测量速度较慢, 比较浪费RAM。
        
	输入值：Flag：选择中位值滤波或中位值平均滤波
		ON：中位值平均滤波  OFF：中位值滤波
  返回值：滤波结果
  备注：中位值滤波：N取奇数，N=2^x次方+1 为宜
	    中位值平均滤波：N=2^x次方+2 为宜
******************************************************/
u32 FILTER_median(u32 *value_buf,u8 N,u8 Flag)//中位值滤波,中位值平均滤波,N为采样次数,取奇数,Flag:中位值平均滤波使能
{
	u32 temp=0;                        
	u32 sum=0;
	u8 i,j;
			
	for(j=0;j<N-1;j++)//排序
    {
		for(i=0;i<N-j-1;i++)        
        {
			if ( value_buf[i] > value_buf[i+1] )
            {
				temp = value_buf[i];
				value_buf[i] = value_buf[i+1];
				value_buf[i+1] = temp;
            }
        }
    }
	if(Flag)
	{
		for(i=1;i<N-1;i++)//中位求平均,由Flag标志控制
			sum+=value_buf[i];
		return (uint32_t)(sum/(N-2));
	}
	else return value_buf[(N-1)/2];//中位值
}

